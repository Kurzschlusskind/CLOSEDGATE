## Kconfig.projbuild
```kconfig
menu "CLOSEDGATE Configuration"

    config CLOSEDGATE_YUBIKEY_ENABLED
        bool "Enable YubiKey OTP Authentication"
        default y
        help
            Enable YubiKey NFC OTP authentication via Yubico Cloud API.
            Requires WiFi connection and valid Yubico Client ID.

    config CLOSEDGATE_MIFARE_ENABLED
        bool "Enable MIFARE Classic Authentication"
        default y
        help
            Enable MIFARE Classic card authentication via UID whitelist.
            Works offline without WiFi connection.

    config CLOSEDGATE_MIFARE_MAX_UIDS
        int "Maximum number of stored MIFARE UIDs"
        default 20
        range 1 100
        depends on CLOSEDGATE_MIFARE_ENABLED
        help
            Maximum number of MIFARE Classic card UIDs that can be stored
            in the whitelist (stored in NVS).

    config CLOSEDGATE_MIFARE_DEFAULT_UIDS
        string "Default MIFARE UIDs (comma-separated hex)"
        default ""
        depends on CLOSEDGATE_MIFARE_ENABLED
        help
            Comma-separated list of default MIFARE Classic UIDs in hex format.
            Example: "A1B2C3D4,11223344AABBCCDD"
            These UIDs are loaded on first boot if NVS is empty.

    config CLOSEDGATE_WIFI_SSID
        string "WiFi SSID"
        default "YourWiFiSSID"
        help
            WiFi network name (SSID) to connect to.

    config CLOSEDGATE_WIFI_PASSWORD
        string "WiFi Password"
        default "YourWiFiPassword"
        help
            WiFi network password (WPA2).

    config CLOSEDGATE_YUBICO_CLIENT_ID
        string "Yubico Client ID"
        default ""
        depends on CLOSEDGATE_YUBIKEY_ENABLED
        help
            Your Yubico API Client ID.
            Register at https://upgrade.yubico.com/getapikey/

    config CLOSEDGATE_RELAY_GPIO
        int "Relay GPIO"
        default 26
        range 0 39
        help
            GPIO pin connected to the relay (Active-High).

    config CLOSEDGATE_RELAY_PULSE_MS
        int "Relay Pulse Duration (ms)"
        default 3000
        range 100 30000
        help
            Duration of the relay activation pulse in milliseconds.

    config CLOSEDGATE_NFC_SDA_GPIO
        int "NFC I2C SDA GPIO"
        default 21
        range 0 39
        help
            GPIO pin for I2C SDA (PN532 NFC module).

    config CLOSEDGATE_NFC_SCL_GPIO
        int "NFC I2C SCL GPIO"
        default 22
        range 0 39
        help
            GPIO pin for I2C SCL (PN532 NFC module).

    config CLOSEDGATE_NFC_POLL_INTERVAL_MS
        int "NFC Polling Interval (ms)"
        default 500
        range 100 5000
        help
            Interval between NFC tag polling attempts in milliseconds.

    config CLOSEDGATE_HTTP_RETRY_COUNT
        int "HTTP Retry Count"
        default 3
        range 1 10
        help
            Number of retry attempts for HTTP requests.

    config CLOSEDGATE_WIFI_RECONNECT_MAX_RETRY
        int "WiFi Reconnect Max Retries"
        default 10
        range 1 100
        help
            Maximum number of WiFi reconnection attempts before giving up.

    config CLOSEDGATE_BUZZER_ENABLED
        bool "Enable Piezo Buzzer"
        default y
        help
            Enable passive piezo buzzer for acoustic feedback.
            Requires a 3-pin passive piezo buzzer connected to the configured GPIO.

    config CLOSEDGATE_BUZZER_GPIO
        int "Buzzer GPIO"
        default 25
        range 0 39
        depends on CLOSEDGATE_BUZZER_ENABLED
        help
            GPIO pin connected to the piezo buzzer signal pin.
            Default: GPIO25.

    config CLOSEDGATE_BUZZER_VOLUME
        int "Buzzer Volume (Duty Cycle %)"
        default 50
        range 10 100
        depends on CLOSEDGATE_BUZZER_ENABLED
        help
            Buzzer volume as LEDC duty cycle percentage.
            50% gives maximum volume for passive piezo buzzers.
            Lower values reduce volume.

    config CLOSEDGATE_BUZZER_BOOT_SOUND
        bool "Play sound on boot"
        default y
        depends on CLOSEDGATE_BUZZER_ENABLED
        help
            Play a startup melody when the system boots successfully.

    config CLOSEDGATE_BUZZER_CARD_SOUND
        bool "Play sound on card detection"
        default y
        depends on CLOSEDGATE_BUZZER_ENABLED
        help
            Play a short beep when an NFC card/tag is detected.

    config CLOSEDGATE_BUZZER_ACCESS_SOUND
        bool "Play sound on access granted/denied"
        default y
        depends on CLOSEDGATE_BUZZER_ENABLED
        help
            Play distinct sounds for access granted and access denied events.

    config CLOSEDGATE_BUZZER_WIFI_SOUND
        bool "Play sound on WiFi events"
        default y
        depends on CLOSEDGATE_BUZZER_ENABLED
        help
            Play sounds when WiFi connects or disconnects.

    config CLOSEDGATE_BUZZER_ERROR_SOUND
        bool "Play sound on errors"
        default y
        depends on CLOSEDGATE_BUZZER_ENABLED
        help
            Play error sound pattern on system errors.

endmenu
```

## main/Kconfig.projbuild
```kconfig
menu "CLOSEDGATE Configuration"

    config CLOSEDGATE_YUBIKEY_ENABLED
        bool "Enable YubiKey OTP Authentication"
        default y
        help
            Enable YubiKey NFC OTP authentication via Yubico Cloud API.
            Requires WiFi connection and valid Yubico Client ID.

    config CLOSEDGATE_MIFARE_ENABLED
        bool "Enable MIFARE Classic Authentication"
        default y
        help
            Enable MIFARE Classic card authentication via UID whitelist.
            Works offline without WiFi connection.

    config CLOSEDGATE_MIFARE_MAX_UIDS
        int "Maximum number of stored MIFARE UIDs"
        default 20
        range 1 100
        depends on CLOSEDGATE_MIFARE_ENABLED
        help
            Maximum number of MIFARE Classic card UIDs that can be stored
            in the whitelist (stored in NVS).

    config CLOSEDGATE_MIFARE_DEFAULT_UIDS
        string "Default MIFARE UIDs (comma-separated hex)"
        default ""
        depends on CLOSEDGATE_MIFARE_ENABLED
        help
            Comma-separated list of default MIFARE Classic UIDs in hex format.
            Example: "A1B2C3D4,11223344AABBCCDD"
            These UIDs are loaded on first boot if NVS is empty.

    config CLOSEDGATE_WIFI_SSID
        string "WiFi SSID"
        default "YourWiFiSSID"
        help
            WiFi network name (SSID) to connect to.

    config CLOSEDGATE_WIFI_PASSWORD
        string "WiFi Password"
        default "YourWiFiPassword"
        help
            WiFi network password (WPA2).

    config CLOSEDGATE_YUBICO_CLIENT_ID
        string "Yubico Client ID"
        default ""
        depends on CLOSEDGATE_YUBIKEY_ENABLED
        help
            Your Yubico API Client ID.
            Register at https://upgrade.yubico.com/getapikey/

    config CLOSEDGATE_RELAY_GPIO
        int "Relay GPIO"
        default 6
        range 0 21
        help
            GPIO pin connected to the relay (Active-High).

    config CLOSEDGATE_RELAY_PULSE_MS
        int "Relay Pulse Duration (ms)"
        default 3000
        range 100 30000
        help
            Duration of the relay activation pulse in milliseconds.

    config CLOSEDGATE_NFC_SDA_GPIO
        int "NFC I2C SDA GPIO"
        default 4
        range 0 21
        help
            GPIO pin for I2C SDA (PN532 NFC module).

    config CLOSEDGATE_NFC_SCL_GPIO
        int "NFC I2C SCL GPIO"
        default 5
        range 0 21
        help
            GPIO pin for I2C SCL (PN532 NFC module).

    config CLOSEDGATE_NFC_POLL_INTERVAL_MS
        int "NFC Polling Interval (ms)"
        default 500
        range 100 5000
        help
            Interval between NFC tag polling attempts in milliseconds.

    config CLOSEDGATE_HTTP_RETRY_COUNT
        int "HTTP Retry Count"
        default 3
        range 1 10
        help
            Number of retry attempts for HTTP requests.

    config CLOSEDGATE_WIFI_RECONNECT_MAX_RETRY
        int "WiFi Reconnect Max Retries"
        default 10
        range 1 100
        help
            Maximum number of WiFi reconnection attempts before giving up.

    config CLOSEDGATE_ENROLL_ENABLED
        bool "Enable card enroll mode via button"
        default y
        depends on CLOSEDGATE_MIFARE_ENABLED
        help
            Enable enrolling new MIFARE cards by pressing a button.
            Hold the button and tap a card to add it to the whitelist.

    config CLOSEDGATE_ENROLL_GPIO
        int "Enroll Button GPIO"
        default 9
        range 0 21
        depends on CLOSEDGATE_ENROLL_ENABLED
        help
            GPIO pin for the enroll button. Default 9 is the BOOT button
            on most ESP32-C3 boards. Active-low (pressed = LOW).

    config CLOSEDGATE_ENROLL_TIMEOUT_S
        int "Enroll mode timeout (seconds)"
        default 10
        range 5 60
        depends on CLOSEDGATE_ENROLL_ENABLED
        help
            How long the enroll mode stays active after button press.

    config CLOSEDGATE_BUZZER_ENABLED
        bool "Enable Piezo Buzzer"
        default y
        help
            Enable passive piezo buzzer for acoustic feedback.
            Requires a 3-pin passive piezo buzzer connected to the configured GPIO.

    config CLOSEDGATE_BUZZER_GPIO
        int "Buzzer GPIO"
        default 7
        range 0 21
        depends on CLOSEDGATE_BUZZER_ENABLED
        help
            GPIO pin connected to the piezo buzzer signal pin.

    config CLOSEDGATE_BUZZER_VOLUME
        int "Buzzer Volume (Duty Cycle %)"
        default 50
        range 10 100
        depends on CLOSEDGATE_BUZZER_ENABLED
        help
            Buzzer volume as LEDC duty cycle percentage.

    config CLOSEDGATE_BUZZER_BOOT_SOUND
        bool "Play sound on boot"
        default y
        depends on CLOSEDGATE_BUZZER_ENABLED

    config CLOSEDGATE_BUZZER_CARD_SOUND
        bool "Play sound on card detection"
        default y
        depends on CLOSEDGATE_BUZZER_ENABLED

    config CLOSEDGATE_BUZZER_ACCESS_SOUND
        bool "Play sound on access granted/denied"
        default y
        depends on CLOSEDGATE_BUZZER_ENABLED

    config CLOSEDGATE_BUZZER_WIFI_SOUND
        bool "Play sound on WiFi events"
        default y
        depends on CLOSEDGATE_BUZZER_ENABLED

    config CLOSEDGATE_BUZZER_ERROR_SOUND
        bool "Play sound on errors"
        default y
        depends on CLOSEDGATE_BUZZER_ENABLED

endmenu
```

## sdkconfig.defaults
```kconfig
# CLOSEDGATE Default Configuration

# Authentication modes
CONFIG_CLOSEDGATE_YUBIKEY_ENABLED=y
CONFIG_CLOSEDGATE_MIFARE_ENABLED=y
CONFIG_CLOSEDGATE_MIFARE_MAX_UIDS=20
CONFIG_CLOSEDGATE_MIFARE_DEFAULT_UIDS=""

# Enable certificate bundle for TLS
CONFIG_MBEDTLS_CERTIFICATE_BUNDLE=y
CONFIG_MBEDTLS_CERTIFICATE_BUNDLE_DEFAULT_FULL=y

# WiFi configuration
CONFIG_ESP_WIFI_SCAN_RSSI_THRESHOLD=-127
CONFIG_ESP_WIFI_NVS_ENABLED=y

# Partition table
CONFIG_PARTITION_TABLE_SINGLE_APP=y

# FreeRTOS
CONFIG_FREERTOS_HZ=1000

# Logging level
CONFIG_LOG_DEFAULT_LEVEL_INFO=y
CONFIG_LOG_DEFAULT_LEVEL=3

# I2C configuration
CONFIG_I2C_MANAGER_0_ENABLED=n
CONFIG_I2C_MANAGER_1_ENABLED=n

# HTTP Client
CONFIG_ESP_HTTP_CLIENT_ENABLE_HTTPS=y

# NVS
CONFIG_NVS_ENCRYPTION=n

# Task watchdog (increase timeout for NFC polling)
CONFIG_ESP_TASK_WDT_TIMEOUT_S=10

# Stack size for main task
CONFIG_ESP_MAIN_TASK_STACK_SIZE=4096

# Flash size
CONFIG_ESPTOOLPY_FLASHSIZE_4MB=y
CONFIG_ESPTOOLPY_FLASHSIZE="4MB"
```
